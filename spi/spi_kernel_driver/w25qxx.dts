/dts-v1/;
/plugin/;

/ {
   compatible = "brcm,bcm2835", "brcm,bcm2836", "brcm,bcm2708", "brcm,bcm2709";

   /* disable spi-dev for spi0.0 */
    fragment@0 {
        target = <&spi0>;
        __overlay__ {
            status = "okay";
            spidev@0{
                status = "disabled";
            };
        };
    };

   fragment@1 {
      target = <&spi0>;
         __overlay__ {
         #address-cell = <1>;
         #size-cell = <0>;
         w25qxx: w25qxx@0{
            compatible = "w25qxx,w25q128";
            reg = <0>;   /* CE2 */
            status = "okay";
            spi-max-frequency = <500000>;
         };

      };
   };


};